## meta-cy/conf/distro/cy-xwayland-initramfs.conf
```bitbake
require conf/distro/fsl-imx-xwayland.conf

INITRAMFS_IMAGE_BUNDLE = "1"
INITRAMFS_IMAGE = "image-tiny-initramfs"
```

## meta-cy/conf/layer.conf
```bitbake
# We have a conf and classes directory, add to BBPATH
BBPATH .= ":${LAYERDIR}"

# We have recipes-* directories, add to BBFILES
BBFILES += "${LAYERDIR}/recipes-*/*/*.bb \
            ${LAYERDIR}/recipes-*/*/*.bbappend"

BBFILE_COLLECTIONS += "meta-cy"
BBFILE_PATTERN_meta-cy = "^${LAYERDIR}/"
BBFILE_PRIORITY_meta-cy = "15"

LAYERDEPENDS_meta-cy = "core meta-engicam-nxp"
LAYERSERIES_COMPAT_meta-cy = "kirkstone"
```

## meta-cy/conf/machine/imx8mp-icore-cy.conf
```bitbake
#@TYPE: Machine
#@NAME: CY machine based on NXP i.MX 8M Plus i.core
#@SOC: i.MX8MP
#@DESCRIPTION: Machine configuration for custom CY imx8mp-icore SOM
#@MAINTAINER: <giometti@enneenne.com>

require conf/machine/include/imx8mp-engicam.inc

KERNEL_DEVICETREE_BASENAME = "imx8mp-icore-cy"

KERNEL_DEVICETREE:append:use-nxp-bsp = " \
	engicam/imx8mp-icore-starterkit.dtb \
	engicam/imx8mp-icore-ctouch2.dtb \
	engicam/imx8mp-icore-cy-board.dtb \
"

UBOOT_CONFIG_BASENAME = "imx8mp_icore_cy"
# UBOOT_DTB_NAME = "imx8mp-icore-cy.dtb"
UBOOT_CONFIG ??= "4gb"
UBOOT_CONFIG[1gb] = "${UBOOT_CONFIG_BASENAME}_1gb_defconfig,sdcard"
UBOOT_CONFIG[2gb] = "${UBOOT_CONFIG_BASENAME}_defconfig,sdcard"
UBOOT_CONFIG[4gb] = "${UBOOT_CONFIG_BASENAME}_4gb_defconfig,sdcard"


# Set DDR FIRMWARE
DDR_FIRMWARE_VERSION = "202006"
DDR_FIRMWARE_NAME = " \
	lpddr4_pmu_train_1d_dmem_${DDR_FIRMWARE_VERSION}.bin \
	lpddr4_pmu_train_1d_imem_${DDR_FIRMWARE_VERSION}.bin \
	lpddr4_pmu_train_2d_dmem_${DDR_FIRMWARE_VERSION}.bin \
	lpddr4_pmu_train_2d_imem_${DDR_FIRMWARE_VERSION}.bin \
"

IMXBOOT_TARGETS_BASENAME = "flash_evk"
IMX_DEFAULT_BSP = "nxp"

IMX_KERNEL_CONFIG_AARCH64 = "imx8_icore_defconfig"

MACHINEOVERRIDES =. "imx8mp-icore:"
```
